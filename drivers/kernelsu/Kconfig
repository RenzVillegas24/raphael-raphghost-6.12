## drivers/kernelsu/Kconfig
```kconfig
menu "KernelSU"

config KSU
	tristate "KernelSU function support"
	depends on KPROBES
	default y
	help
	  Enable kernel-level root privileges on Android System.
	  Requires CONFIG_KPROBES for kernel hooking support.
	  Requires CONFIG_EXT4_FS for `ext4_unregister_sysfs`.
	  To compile as a module, choose M here: the
	  module will be called kernelsu.

config KSU_DEBUG
	bool "KernelSU debug mode"
	depends on KSU
	default n
	help
	  Enable KernelSU debug mode.

config KSU_DISABLE_MANAGER
	bool "Disable KernelSU manager integration"
	depends on KSU
	default n
	help
	  Disable manager APK detection and manager-specific handling.
	  Root will be used in place of manager-only functionality.

config KSU_DISABLE_POLICY
	bool "Disable KernelSU policy profiles"
	depends on KSU
	default n
	help
	  Disable per-app root/non-root profile customization.
	  Escalation will always use the default full root profile, and
	  non-root handling will follow the global umount policy only.

config KSU_X86_PATCH_SYSCALL_DISPATCHER
	bool "Dynamically patch x64's hardened syscall dispatcher to support syscall hooks"
	depends on KSU && X86_64
	default n
	help
	  Dynamically patch x64's hardened syscall dispatcher to support syscall hooks. This is a
	  replacement for a kernel source code patch, and is useful for x86_64 LKM mode.

menu "KernelSU - SUSFS"
	depends on KSU

config KSU_SUSFS
	bool "KernelSU - SUSFS support"
	default y
	help
	  Enable SuSFS root-hiding subsystem for KernelSU.

config KSU_SUSFS_SUS_PATH
	bool "SUSFS - Enable SUS_PATH feature"
	depends on KSU_SUSFS
	default y
	help
	  Hide specific filesystem paths from unauthorized userspace inspection.

config KSU_SUSFS_SUS_MOUNT
	bool "SUSFS - Enable SUS_MOUNT feature"
	depends on KSU_SUSFS
	default y
	help
	  Hide overlay and bind mounts from /proc/mounts and /proc/[pid]/mountinfo.

config KSU_SUSFS_SUS_KSTAT
	bool "SUSFS - Enable SUS_KSTAT feature"
	depends on KSU_SUSFS
	default y
	help
	  Spoof inode attributes, stat, and statfs calls.

config KSU_SUSFS_SPOOF_UNAME
	bool "SUSFS - Enable SPOOF_UNAME feature"
	depends on KSU_SUSFS
	default y
	help
	  Spoof kernel release and version returned by uname(2).

config KSU_SUSFS_ENABLE_LOG
	bool "SUSFS - Enable logging"
	depends on KSU_SUSFS
	default y
	help
	  Enable kernel log buffer tracing for SuSFS events.

config KSU_SUSFS_HIDE_KSU_SUSFS_SYMBOLS
	bool "SUSFS - Hide KSU and SUSFS symbols"
	depends on KSU_SUSFS
	default y
	help
	  Filter and hide KernelSU and SuSFS symbols from kallsyms.

config KSU_SUSFS_SPOOF_CMDLINE_OR_BOOTCONFIG
	bool "SUSFS - Spoof /proc/cmdline or bootconfig"
	depends on KSU_SUSFS
	default y
	help
	  Spoof /proc/cmdline and bootconfig contents to remove root/debug flags.

config KSU_SUSFS_OPEN_REDIRECT
	bool "SUSFS - Enable OPEN_REDIRECT feature"
	depends on KSU_SUSFS
	default y
	help
	  Redirect file open calls from target paths to spoofed alternatives.

config KSU_SUSFS_SUS_MAP
	bool "SUSFS - Enable SUS_MAP feature"
	depends on KSU_SUSFS
	default y
	help
	  Hide memory mappings and /proc/[pid]/maps entries.

endmenu

endmenu
```

## drivers/soc/qcom/raphael/Kconfig
```kconfig
# SPDX-License-Identifier: GPL-2.0
menu "Xiaomi Redmi K20 Pro (Raphael) Hardware Support"

config MACH_XIAOMI_SM8150
	bool "Xiaomi SM8150 platform support"
	default y
	help
	  Support for Xiaomi smartphones based on Qualcomm SM8150 (Snapdragon 855).

config MACH_XIAOMI_RAPHAEL
	bool "Xiaomi Redmi K20 Pro / Mi 9T Pro (raphael)"
	depends on MACH_XIAOMI_SM8150
	default y
	help
	  Support for Xiaomi Redmi K20 Pro / Mi 9T Pro (codename: raphael).

config REGULATOR_RAPHAEL_PD
	bool "Raphael Power Delivery (PD) regulator support"
	depends on MACH_XIAOMI_RAPHAEL
	default y
	help
	  Enables USB-C Power Delivery and fast charging voltage regulation on Raphael.

config RAPHAEL_AUDIO_TECHPACK
	bool "Raphael Audio Techpack support"
	depends on MACH_XIAOMI_RAPHAEL
	default y
	help
	  Enables Qualcomm Audio Techpack integration including TFA98xx smart amp and WCD934x codec.

config RAPHAEL_DSP_BOOT
	bool "Raphael Audio/Wearable DSP boot control"
	depends on MACH_XIAOMI_RAPHAEL
	default y
	help
	  Sysfs control interface for booting and monitoring ADSP/WDSP firmware.

config RAPHAEL_MMCX_HOLD
	bool "Raphael MMCX voltage hold"
	depends on MACH_XIAOMI_RAPHAEL
	default y
	help
	  Ensures memory rail voltage stability during dynamic frequency scaling.

config RAPHAEL_RQ_STATS
	bool "Raphael runqueue statistics"
	depends on MACH_XIAOMI_RAPHAEL
	default y
	help
	  Collects CPU runqueue depth and scheduling load statistics.

config RAPHAEL_DEVFREQ_FLOOR
	bool "Raphael devfreq floor regulator"
	depends on MACH_XIAOMI_RAPHAEL
	default y
	help
	  Enforces minimum devfreq bandwidth and frequency floors.

endmenu
```
